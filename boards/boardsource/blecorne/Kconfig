## boards/boardsource/blecorne/Kconfig
```kconfig
#
# Copyright (c) 2022 The ZMK Contributors
# SPDX-License-Identifier: MIT
#

config BOARD_BLECORNE_LEFT
    bool

config BOARD_BLECORNE_RIGHT
    bool
```
